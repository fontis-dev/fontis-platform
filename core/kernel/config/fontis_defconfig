## core/kernel/config/fontis_defconfig
```kconfig
# Fontis Platform Kernel Configuration
# Based on Linux x86-64 defconfig with additions for Fontis hardware

CONFIG_64BIT=y
CONFIG_X86_64=y

# Security
CONFIG_SECURITY=y
CONFIG_SECURITY_SELINUX=y
CONFIG_SECURITY_APPARMOR=y
CONFIG_INTEGRITY=y
CONFIG_INTEGRITY_SIGNATURE=y
CONFIG_IMA=y
CONFIG_IMA_APPRAISE=y
CONFIG_EVM=y
CONFIG_SECURITY_YAMA=y

# Crypto (for dm-crypt, TPM, signatures)
CONFIG_CRYPTO=y
CONFIG_CRYPTO_AES_NI_INTEL=y
CONFIG_CRYPTO_SHA256=y
CONFIG_CRYPTO_SHA512=y
CONFIG_CRYPTO_USER_API_HASH=y
CONFIG_CRYPTO_USER_API_SKCIPHER=y

# Device Mapper (dm-crypt, dm-verity, dm-integrity)
CONFIG_BLK_DEV_DM=y
CONFIG_DM_CRYPT=y
CONFIG_DM_VERITY=y
CONFIG_DM_INTEGRITY=y
CONFIG_DM_THIN_PROVISIONING=y

# TPM
CONFIG_TCG_TPM=y
CONFIG_TCG_TIS=y
CONFIG_TCG_TIS_SPI=y
CONFIG_TCG_CRB=y

# Storage
CONFIG_BLK_DEV_NVME=y
CONFIG_ATA=y
CONFIG_SATA_AHCI=y
CONFIG_BTRFS_FS=y
CONFIG_BTRFS_FS_POSIX_ACL=y
CONFIG_F2FS_FS=y
CONFIG_EXT4_FS=y
CONFIG_EXT4_FS_POSIX_ACL=y
CONFIG_XFS_FS=y
CONFIG_VFAT_FS=y

# Networking
CONFIG_NET=y
CONFIG_WIRELESS=y
CONFIG_CFG80211=y
CONFIG_MAC80211=y
CONFIG_WLAN=y
CONFIG_IWLWIFI=y
CONFIG_ATH=y
CONFIG_ATH10K=y
CONFIG_RTW88=y
CONFIG_R8169=y
CONFIG_E1000E=y
CONFIG_IGB=y
CONFIG_NETDEVICES=y
CONFIG_TUN=y
CONFIG_WIREGUARD=y
CONFIG_NF_CONNTRACK=y
CONFIG_NETFILTER=y
CONFIG_NFTABLES=y
CONFIG_BRIDGE=y
CONFIG_VLAN_8021Q=y
CONFIG_DNS_RESOLVER=y
CONFIG_MDNS=y

# UEFI
CONFIG_EFI=y
CONFIG_EFI_STUB=y
CONFIG_EFI_MIXED=y
CONFIG_EFI_GENERIC_STUB_INITRD_CMDLINE_LOADER=y
CONFIG_EFI_CUSTOM_SSDT_OVERLAYS=y

# Firmware
CONFIG_FW_LOADER=y
CONFIG_FIRMWARE_IN_KERNEL=y

# USB
CONFIG_USB=y
CONFIG_USB_XHCI_HCD=y
CONFIG_USB_EHCI_HCD=y
CONFIG_USB_STORAGE=y

# System
CONFIG_CGROUPS=y
CONFIG_CGROUP_BPF=y
CONFIG_NAMESPACES=y
CONFIG_USER_NS=y
CONFIG_SECCOMP=y
CONFIG_SECCOMP_FILTER=y
CONFIG_BPF=y
CONFIG_BPF_SYSCALL=y
CONFIG_OVERLAY_FS=y
CONFIG_SQUASHFS=y
CONFIG_SQUASHFS_XZ=y
CONFIG_AUDIT=y
CONFIG_AUDITSYSCALL=y

# Hardware monitoring
CONFIG_SENSORS_CORETEMP=y
CONFIG_SENSORS_DRIVETEMP=y

# ACPI
CONFIG_ACPI=y
CONFIG_ACPI_BUTTON=y
CONFIG_ACPI_FAN=y
CONFIG_ACPI_PROCESSOR=y
CONFIG_ACPI_THERMAL=y
```

## core/meta-fontis/conf/layer.conf
```bitbake
BBPATH .= ":${LAYERDIR}"
BBFILES += "${LAYERDIR}/recipes-*/*/*.bb \
            ${LAYERDIR}/recipes-*/*/*.bbappend"

BBFILE_COLLECTIONS += "fontis"
BBFILE_PATTERN_fontis = "^${LAYERDIR_RE}/"
BBFILE_PRIORITY_fontis = "10"

LAYERDEPENDS_fontis = "core openembedded-layer meta-security"
LAYERSERIES_COMPAT_fontis = "kirkstone scarthgap"
```
